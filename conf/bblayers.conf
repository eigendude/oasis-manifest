## conf/bblayers.conf
```bitbake
################################################################################
#
#  Copyright (C) 2022 Garrett Brown
#  This file is part of oasis-manifest - https://github.com/eigendude/oasis-manifest
#
#  SPDX-License-Identifier: Apache-2.0
#  See LICENSES/README.md for more information.
#
################################################################################

# LAYER_CONF_VERSION is increased each time build/conf/bblayers.conf
# changes incompatibly
LCONF_VERSION = "7"
OEROOT := "${@os.path.abspath(os.path.dirname(d.getVar('FILE', True)))}/.."

# Select the ROS distro to build with. See meta-ros layer for valid distros.
ROS_DISTRO = "humble"

# Set this to "ros1" or "ros2" depending on the distro
ROS_VERSION_NAME = "ros2"

BBPATH = "${TOPDIR}"

BBFILES = ""

# These layers hold recipe metadata not found in OE-core, but lack any machine
# or distro content
BASELAYERS ?= " \
  ${OEROOT}/layers/meta-openembedded/meta-filesystems \
  ${OEROOT}/layers/meta-openembedded/meta-multimedia \
  ${OEROOT}/layers/meta-openembedded/meta-networking \
  ${OEROOT}/layers/meta-openembedded/meta-oe \
  ${OEROOT}/layers/meta-openembedded/meta-python \
"

# ROS recipes
BASELAYERS += " \
  ${OEROOT}/layers/meta-ros/meta-ros-common \
  ${OEROOT}/layers/meta-ros/meta-ros-backports-dunfell \
  ${OEROOT}/layers/meta-ros/meta-${ROS_VERSION_NAME} \
  ${OEROOT}/layers/meta-ros/meta-${ROS_VERSION_NAME}-${ROS_DISTRO} \
"

# Mender recipes
BASELAYERS += " \
  ${OEROOT}/layers/meta-mender/meta-mender-core \
"
#  ${OEROOT}/layers/meta-mender/meta-mender-raspberrypi

# These layers hold machine specific content, aka Board Support Packages
BSPLAYERS ?= " \
  ${OEROOT}/layers/meta-bbb \
  ${OEROOT}/layers/meta-jumpnow \
  ${OEROOT}/layers/meta-raspberrypi \
"

# Add your overlay location to EXTRALAYERS
# Make sure to have a conf/layers.conf in there
EXTRALAYERS ?= " \
"

BBLAYERS = " \
  ${OEROOT}/layers/meta-oasis \
  ${BASELAYERS} \
  ${BSPLAYERS} \
  ${EXTRALAYERS} \
  ${OEROOT}/layers/openembedded-core/meta \
"
```

## conf/local.conf
```bitbake
################################################################################
#
#  Copyright (C) 2022 Garrett Brown
#  This file is part of oasis-manifest - https://github.com/eigendude/oasis-manifest
#
#  SPDX-License-Identifier: Apache-2.0
#  See LICENSES/README.md for more information.
#
################################################################################

#
# This file is your local configuration file and is where all local user settings
# are placed. The comments in this file give some guide to the options a new user
# to the system might want to change but pretty much any configuration option can
# be set in this file. More adventurous users can look at local.conf.extended
# which contains other examples of configuration which can be placed in this file
# but new users likely won't need any of them initially.
#
# Lines starting with the '#' character are commented out and in some cases the
# default values are provided as comments to show people example syntax. Enabling
# the option is a question of removing the # character and making any change to the
# variable as required.

###############################################################################
# Distro parameters
###############################################################################

# Set BitBake distro variables
DISTRO ?= "oasis"
DISTRO_CODENAME = "${IMAGE_BASENAME}"

# Skip recipes from meta-bbb layer
BBMASK = "meta-bbb/recipes-mender"
BBMASK .= "|meta-bbb/recipes-qt"

#
# Additional image features
#
# The following is a list of additional classes to use when building images which
# enable extra features. Some available options which can be included in this variable
# are:
#   - 'buildstats' collect build statistics
#   - 'image-mklibs' to reduce shared library files size for an image
#   - 'image-prelink' in order to prelink the filesystem image
# NOTE: if listing mklibs & prelink both, then make sure mklibs is before prelink
# NOTE: mklibs also needs to be explicitly enabled for a given image, see local.conf.extended
USER_CLASSES ?= " \
    buildstats \
    image-mklibs \
    image-prelink \
"

#
# Extra image configuration defaults
#
# The EXTRA_IMAGE_FEATURES variable allows extra packages to be added to the generated
# images. Some of these options are added to certain image types automatically. The
# variable can contain the following options:
#  "dbg-pkgs"       - add -dbg packages for all installed packages
#                     (adds symbol information for debugging/profiling)
#  "src-pkgs"       - add -src packages for all installed packages
#                     (adds source code for debugging)
#  "dev-pkgs"       - add -dev packages for all installed packages
#                     (useful if you want to develop against libs in the image)
#  "ptest-pkgs"     - add -ptest packages for all ptest-enabled packages
#                     (useful if you want to run the package test suites)
#  "debug-tweaks"   - make an image suitable for development
#                     e.g. ssh root access has a blank password
#  "bash-completion-pkgs" - packages for Bash completion
#                     (added in Yocto 3.0 Zeus)
#  "splash"         - show a splash screen during boot
#
# There are other application targets that can be used here too, see
# meta/classes/image.bbclass and meta/classes/core-image.bbclass for more details.
EXTRA_IMAGE_FEATURES = " \
    package-management \
"

#
# Package management configuration
#
# The variable PACKAGE_CLASSES defines the which package manager used to build
# the packages (among RPM, DEB, and IPK).
PACKAGE_CLASSES = "package_ipk"

###############################################################################
# Version parameters
###############################################################################

# CONF_VERSION is increased each time build/conf/ changes incompatibly and is
# used to track the version of this file when it was generated.
CONF_VERSION = "1"

# The major version is incresed for changes in architecture, hardware support,
# or as desired for marketing reasons.
VERSION_MAJOR = "1"

# The minor version is generally increased at a steady cadence, and is also
# influenced by feature additions and substantial functionality changes.
VERSION_MINOR = "0"

# The patch version is incremented for bug fixes and refinements. During
# development, this version is bumped.
VERSION_PATCH = "0"

# The version tag is set for pre-release versions. Examples are "-alpha1",
# "-beta2", and "-rc3". While working toward a pre-release, set this to "-dev".
VERSION_TAG = "-dev"

# The version code is composed of the version components above
VERSION_CODE = "${VERSION_MAJOR}.${VERSION_MINOR}.${VERSION_PATCH}${VERSION_TAG}"

#
# To allow for pre-release OTA updates, the version code for packages uses the
# major/minor version of the previous release, with a patch equal to YXX,
# where:
#
#   - Y is 7 for alpha, 8 for beta, and 9 for release candidate
#   - XX is the alpha/beta/release candidate number.
#
# When bumping the major version, the same strategy applies, but to the minor
# version instead of the patch. For example, when bumping to 2.0.0, the package
# version code is 1.901.0.
#
# During development, this version is not bumped. E.g.:
#
# VERSION_MAJOR = "1"
# VERSION_MINOR = "0"
# VERSION_PATCH = "0"
# VERSION_TAG = "-dev"
# PV_CODE = "0.0.777"
#
PV_CODE = "0.0.777"

# Set BitBake distro variables
DISTRO_VERSION = "${VERSION_CODE}"

###############################################################################
# Path parameters
###############################################################################

# Set DEPLOY_DIR outside of TMPDIR
DEPLOY_DIR = "${TMPDIR}/../deploy/${DISTRO}-${TCLIBC}"

#
# Disk Space Monitoring during the build
#
# Monitor the disk space during the build. If there is less that 1GB of space or less
# than 100K inodes in any key build location (TMPDIR, DL_DIR, SSTATE_DIR), gracefully
# shutdown the build. If there is less than 100MB or 1K inodes, perform a hard abort
# of the build. The reason for this is that running completely out of space can corrupt
# files and damages the build in ways which may not be easily recoverable.
# It's necesary to monitor /tmp, if there is no space left the build will fail
# with very exotic errors.
BB_DISKMON_DIRS ??= "\
    STOPTASKS,${TMPDIR},1G,100K \
    STOPTASKS,${DL_DIR},1G,100K \
    STOPTASKS,${SSTATE_DIR},1G,100K \
    STOPTASKS,/tmp,100M,100K \
    ABORT,${TMPDIR},100M,1K \
    ABORT,${DL_DIR},100M,1K \
    ABORT,${SSTATE_DIR},100M,1K \
    ABORT,/tmp,10M,1K"

###############################################################################
# Build parameters
###############################################################################

#
# Build system options
#

# Don't clear temporary files
INHERIT_remove = "rm_work"

# This QA test causes problems when buildhistory is enabled
ERROR_QA_remove = "version-going-backwards"

#
# Install options
#

# What kind of images do we want?
IMAGE_FSTYPES = "ext4 wic"

# Don't generate the mirror tarball for SCM repos, the snapshot is enough
BB_GENERATE_MIRROR_TARBALLS = "0"

#
# Development options
#

# A development build will include tools like gcc for developing on the device.
BUILD_DEVELOPMENT = "0"

# Conditionally set other development flags
EXTRA_IMAGE_FEATURES += "${@'dev-pkgs' if d.getVar('BUILD_DEVELOPMENT') == '1' else ''}"

#
# Debug options
#

#
# A debug build will include debug symbols in the compiled binaries. This can
# drastically inflate the size of the build.
#
# Building in debug mode will also add common debugging tools, like nm and
# ldd.
DEBUG_BUILD = "0"

# Conditionally set other debug flags
INHIBIT_PACKAGE_DEBUG_SPLIT = "${@'1' if d.getVar('DEBUG_BUILD') == '1' else '0'}"
INHIBIT_PACKAGE_STRIP = "${@'1' if d.getVar('DEBUG_BUILD') == '1' else '0'}"
EXTRA_IMAGE_FEATURES += "${@'dbg-pkgs' if d.getVar('DEBUG_BUILD') == '1' else ''}"

#
# Performance options
#

# These two options control how much parallelism BitBake should use. The first
# option determines how many tasks bitbake should run in parallel:
# Default to setting automatically based on cpu count
BB_NUMBER_THREADS ?= "${@oe.utils.cpu_count()}"

# The second option controls how many processes make should run in parallel when
# running compile tasks:
# Default to setting automatically based on cpu count
PARALLEL_MAKE ?= "-j ${@oe.utils.cpu_count()}"

# Disable build time patch resolution. This would lauch a devshell
# and wait for manual intervention. We disable it.
PATCHRESOLVE = "noop"

###############################################################################
# Test parameters
###############################################################################

#
# Runtime testing of images
#
# The build system can test booting virtual machine images under qemu (an emulator)
# after any root filesystems are created and run tests against those images. To
# enable this uncomment this line. See classes/testimage(-auto).bbclass for
# further details.
#TEST_IMAGE = "1"
```
